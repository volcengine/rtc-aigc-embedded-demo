## client/espressif/esp32s3_demo/main/Kconfig.projbuild
```kconfig
menu "Example Configuration"

choice AI_AGENT_MODE
    prompt "Volcano RTC mode or Coze RTC mode"
    default VOLC_RTC_MODE

    config VOLC_RTC_MODE
        bool "enable volcano rtc mode"

    config COZE_RTC_MODE
        bool "enable coze rtc mode"
endchoice



config RTC_APPID
    string "RTC_APPID"
    default "******"
    depends on VOLC_RTC_MODE

config AIGENT_SERVER_HOST
    string "AIGC SERVER IP:PORT"
    default "192.***.***.2:8080"
    depends on VOLC_RTC_MODE

config COZE_SERVER_HOST
    string "Coze server host: https://www.coze.cn/open/docs/dev_how_to_guides/access_process"
    default "https://api.coze.cn/v1/audio/rooms"
    depends on COZE_RTC_MODE

config COZE_AUTH
    string "Coze authonrization: https://www.coze.cn/open/oauth/pats"
    depends on COZE_RTC_MODE

config COZE_BOT_ID
    string "Coze bot id: https://www.coze.cn/open/docs/guides/agent_quick_start"
    depends on COZE_RTC_MODE

choice AUDIO_CODEC_SUPPORT
    prompt "Audio Codec"
    default AUDIO_CODEC_TYPE_PCM

config AUDIO_CODEC_TYPE_PCM
    bool "audio codec is pcm, use internal audio codec instead"

config AUDIO_CODEC_TYPE_OPUS
    bool "audio codec is opus"
    depends on VOLC_RTC_MODE

config AUDIO_CODEC_TYPE_G711A
    bool "audio codec is g711a"

config AUDIO_CODEC_TYPE_G722
    bool "audio codec is g722, not support yet"

config AUDIO_CODEC_TYPE_AACLC
    bool "audio codec is aaclc, not support yet"

endchoice
endmenu
```

## client/espressif/esp32s3_demo/sdkconfig.defaults
```kconfig
#
# Partition Table
#
# CONFIG_PARTITION_TABLE_SINGLE_APP is not set
# CONFIG_PARTITION_TABLE_SINGLE_APP_LARGE is not set
# CONFIG_PARTITION_TABLE_TWO_OTA is not set
CONFIG_PARTITION_TABLE_CUSTOM=y
CONFIG_PARTITION_TABLE_CUSTOM_FILENAME="partitions.csv"
CONFIG_PARTITION_TABLE_FILENAME="partitions.csv"
CONFIG_PARTITION_TABLE_OFFSET=0x8000
CONFIG_PARTITION_TABLE_MD5=y
# end of Partition Table


#
# Audio HAL
#
# CONFIG_AUDIO_BOARD_CUSTOM is not set
# CONFIG_ESP_LYRAT_V4_3_BOARD is not set
# CONFIG_ESP_LYRAT_V4_2_BOARD is not set
# CONFIG_ESP_LYRATD_MSC_V2_1_BOARD is not set
# CONFIG_ESP_LYRATD_MSC_V2_2_BOARD is not set
# CONFIG_ESP_LYRAT_MINI_V1_1_BOARD is not set
# CONFIG_ESP32_KORVO_DU1906_BOARD is not set
# CONFIG_ESP32_S2_KALUGA_1_V1_2_BOARD is not set
CONFIG_ESP32_S3_KORVO2_V3_BOARD=y
# CONFIG_ESP32_S3_KORVO2L_V1_BOARD is not set
# CONFIG_ESP32_S3_BOX_LITE_BOARD is not set
# CONFIG_ESP32_S3_BOX_BOARD is not set
# CONFIG_ESP32_S3_BOX_3_BOARD is not set
# CONFIG_ESP32_C3_LYRA_V2_BOARD is not set
# CONFIG_ESP32_C6_DEVKIT_BOARD is not set
# CONFIG_ESP32_P4_FUNCTION_EV_BOARD is not set
# end of Audio HAL


#
# Common ESP-related
#
CONFIG_ESP_ERR_TO_NAME_LOOKUP=y
CONFIG_ESP_ALLOW_BSS_SEG_EXTERNAL_MEMORY=y
# end of Common ESP-related

#
# ESP PSRAM
#
CONFIG_SPIRAM=y

#
# SPI RAM config
#
# CONFIG_SPIRAM_MODE_QUAD is not set
CONFIG_SPIRAM_MODE_OCT=y
CONFIG_SPIRAM_TYPE_AUTO=y
# CONFIG_SPIRAM_TYPE_ESPPSRAM64 is not set
CONFIG_SPIRAM_ALLOW_STACK_EXTERNAL_MEMORY=y
CONFIG_SPIRAM_CLK_IO=30
CONFIG_SPIRAM_CS_IO=26
CONFIG_SPIRAM_XIP_FROM_PSRAM=y
CONFIG_SPIRAM_FETCH_INSTRUCTIONS=y
# CONFIG_SPIRAM_RODATA is not set
CONFIG_SPIRAM_SPEED_80M=y
# CONFIG_SPIRAM_SPEED_40M is not set
CONFIG_SPIRAM_SPEED=80
# CONFIG_SPIRAM_ECC_ENABLE is not set
CONFIG_SPIRAM_BOOT_INIT=y
# CONFIG_SPIRAM_USE_MEMMAP is not set
# CONFIG_SPIRAM_USE_CAPS_ALLOC is not set
CONFIG_SPIRAM_USE_MALLOC=y
CONFIG_SPIRAM_MEMTEST=y
CONFIG_SPIRAM_MALLOC_ALWAYSINTERNAL=16384
CONFIG_SPIRAM_TRY_ALLOCATE_WIFI_LWIP=y
CONFIG_SPIRAM_MALLOC_RESERVE_INTERNAL=32768
CONFIG_SPIRAM_ALLOW_BSS_SEG_EXTERNAL_MEMORY=y
# end of SPI RAM config
# end of ESP PSRAM


#
# FreeRTOS
#

#
# Kernel
#

CONFIG_FREERTOS_HZ=1000

CONFIG_FREERTOS_USE_TRACE_FACILITY=y
CONFIG_FREERTOS_USE_STATS_FORMATTING_FUNCTIONS=y
CONFIG_FREERTOS_USE_LIST_DATA_INTEGRITY_CHECK_BYTES=y
CONFIG_FREERTOS_VTASKLIST_INCLUDE_COREID=y
CONFIG_FREERTOS_GENERATE_RUN_TIME_STATS=y
CONFIG_FREERTOS_RUN_TIME_COUNTER_TYPE_U32=y
# CONFIG_FREERTOS_RUN_TIME_COUNTER_TYPE_U64 is not set
CONFIG_FREERTOS_USE_APPLICATION_TASK_TAG=y
# end of Kernel

#
# Port
#

CONFIG_FREERTOS_RUN_TIME_STATS_USING_ESP_TIMER=y
# end of Port

# end of FreeRTOS

#
# mbedTLS
#
# CONFIG_MBEDTLS_INTERNAL_MEM_ALLOC is not set
CONFIG_MBEDTLS_EXTERNAL_MEM_ALLOC=y
# CONFIG_MBEDTLS_HARDWARE_AES is not set
# CONFIG_MBEDTLS_HARDWARE_SHA is not set
# end of mbedTLS


#
# Serial flasher config
#
CONFIG_ESPTOOLPY_FLASHMODE_QIO=y
# CONFIG_ESPTOOLPY_FLASHMODE_QOUT is not set
# CONFIG_ESPTOOLPY_FLASHMODE_DIO is not set

# CONFIG_ESPTOOLPY_FLASHSIZE_1MB is not set
# CONFIG_ESPTOOLPY_FLASHSIZE_2MB is not set
# CONFIG_ESPTOOLPY_FLASHSIZE_4MB is not set
# CONFIG_ESPTOOLPY_FLASHSIZE_8MB is not set
CONFIG_ESPTOOLPY_FLASHSIZE_16MB=y
# CONFIG_ESPTOOLPY_FLASHSIZE_32MB is not set
# CONFIG_ESPTOOLPY_FLASHSIZE_64MB is not set
# CONFIG_ESPTOOLPY_FLASHSIZE_128MB is not set
CONFIG_ESPTOOLPY_FLASHSIZE="16MB"
# end of Serial flasher config

#
# ESP System Settings
#
# CONFIG_ESP_DEFAULT_CPU_FREQ_MHZ_80 is not set
# CONFIG_ESP_DEFAULT_CPU_FREQ_MHZ_160 is not set
CONFIG_ESP_DEFAULT_CPU_FREQ_MHZ_240=y
CONFIG_ESP_DEFAULT_CPU_FREQ_MHZ=240



#
# Example Connection Configuration
#

CONFIG_EXAMPLE_WIFI_SSID="booka"
CONFIG_EXAMPLE_WIFI_PASSWORD="55555555"

# end of Example Connection Configuration
```
